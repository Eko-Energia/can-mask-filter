VERSION ""

NS_ :

BS_:

BU_:

BO_ 256 EngineData: 8 Vector__XXX
 SG_ EngineSpeed : 0|16@1+ (1,0) [0|0] "rpm" Vector__XXX
 SG_ EngineTemp : 16|8@1+ (1,0) [0|0] "degC" Vector__XXX

BO_ 257 VehicleSpeed: 8 Vector__XXX
 SG_ Speed : 0|16@1+ (1,0) [0|0] "km/h" Vector__XXX

BO_ 258 BodyControl: 8 Vector__XXX
 SG_ DoorStatus : 0|8@1+ (1,0) [0|0] "" Vector__XXX

BO_ 512 ABS_Data: 8 Vector__XXX
 SG_ WheelSpeed : 0|16@1+ (1,0) [0|0] "rpm" Vector__XXX
