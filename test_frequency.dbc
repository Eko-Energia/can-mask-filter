VERSION ""

NS_ :

BS_:

BU_: EngineECU BodyECU ABS

BO_ 256 EngineStatus: 8 EngineECU
 SG_ RPM : 0|16@1+ (1,0) [0|8000] "rpm" Vector__XXX

BO_ 257 EngineTemp: 8 EngineECU
 SG_ Temp : 0|8@1+ (1,-40) [-40|150] "C" Vector__XXX

BO_ 512 BodyStatus: 4 BodyECU
 SG_ DoorOpen : 0|1@1+ (1,0) [0|1] "" Vector__XXX

BO_ 768 WheelSpeeds: 8 ABS
 SG_ FL : 0|16@1+ (0.1,0) [0|300] "km/h" Vector__XXX
 SG_ FR : 16|16@1+ (0.1,0) [0|300] "km/h" Vector__XXX

BA_DEF_ BO_  "GenMsgCycleTime" INT 0 65535;
BA_DEF_DEF_  "GenMsgCycleTime" 100;
BA_ "GenMsgCycleTime" BO_ 256 10;
BA_ "GenMsgCycleTime" BO_ 257 1000;
BA_ "GenMsgCycleTime" BO_ 512 500;
BA_ "GenMsgCycleTime" BO_ 768 20;
